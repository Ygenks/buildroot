/* SPDX-License-Identifier: (GPL-2.0+ OR BSD-3-Clause) */
/* Copyright (C) STMicroelectronics 2017 - All Rights Reserved */

#include "stm32f429.dtsi"

/ {
	soc {
		dsi: dsi@40016c00 {
			compatible = "st,stm32-dsi";
			reg = <0x40016c00 0x800>;
			resets = <&rcc STM32F4_APB2_RESET(DSI)>;
			reset-names = "apb";
			clocks = <&rcc 1 CLK_F469_DSI>, <&clk_hse>;
			clock-names = "pclk", "ref";
			status = "disabled";
		};

        qspi: spi@58003000 {
            compatible = "st,stm32f469-qspi";
            reg = <0x58003000 0x1000>,
            <0x90000000 0x10000000>;
            reg-names = "qspi", "qspi_mm";
            interrupts = <92>;
            /* dmas = <&dma2 3 7 0x400 0x0>, */
	        /* <&dma2 3 7 0x400 0x0>; */
            dma-names = "tx", "rx";
            clocks = <&rcc 0 STM32F4_AHB3_CLOCK(QSPI)>;
            resets = <&rcc STM32F4_AHB3_RESET(QSPI)>;
            status = "disabled";
        };
	};
};
